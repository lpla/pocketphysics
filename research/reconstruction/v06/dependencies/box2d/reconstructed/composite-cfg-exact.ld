SECTIONS
{
  .text :
  {
    /tmp/core-donor-labels-global-notarget.o(.text._Z9intersectRK6b2Vec2S1_S1_S1_RS_)
    /tmp/core-donor-labels-global-notarget.o(.text._Z9intersectRK6b2Vec2S1_S1_S1_)
    /tmp/core-donor-labels-global-notarget.o(.text._ZN9b2PolygonC1Ev)
    /tmp/core-donor-labels-global-notarget.o(.text._ZN9b2Polygon7GetAreaEv)
    /tmp/core-donor-labels-global-notarget.o(.text._ZN9b2Polygon5IsCCWEv)
    /tmp/core-donor-labels-global-notarget.o(.text._ZN9b2Polygon8IsConvexEv)
    /tmp/core-donor-labels-global-notarget.o(.text._ZN9b2Polygon8IsSimpleEv)
    /tmp/core-donor-labels-global-notarget.o(.text._Z14ReversePolygonP5FixedS0_i)
    /tmp/core-donor-labels-global-notarget.o(.text._Z14ReversePolygonR9b2Polygon)
    /tmp/core-donor-labels-global-notarget.o(.text._Z9IsRighter5FixedS_S_S_)
    /tmp/core-donor-labels-global-notarget.o(.text._Z9remainderll)
    /tmp/core-donor-labels-global-notarget.o(.text._ZN10b2PolyNodeC1Ev)
    /tmp/core-donor-labels-global-notarget.o(.text._ZN10b2PolyNodeC1ER6b2Vec2)
    /tmp/core-donor-labels-global-notarget.o(.text._ZN10b2PolyNode23RemoveConnectionByIndexEl)
    /tmp/core-donor-labels-global-notarget.o(.text._ZN10b2PolyNode13IsConnectedToERS_)
    /tmp/core-donor-labels-global-notarget.o(.text._ZN10b2PolyNode16RemoveConnectionERS_)
    /tmp/core-donor-labels-global-notarget.o(.text._ZN10b2PolyNode13AddConnectionERS_)
    /tmp/core-donor-labels-global-notarget.o(.text._ZN9b2PolygonC1ER10b2Triangle)
    /tmp/core-donor-labels-global-notarget.o(.text._ZN9b2Polygon13GetVertexVecsEv)
    /tmp/core-donor-labels-global-notarget.o(.text._ZN9b2PolygonC1EP5FixedS1_l)
    /tmp/core-donor-labels-global-notarget.o(.text._ZN9b2Polygon5AddToER12b2PolygonDef)
    /tmp/core-donor-labels-global-notarget.o(.text._ZN9b2Polygon3AddER10b2Triangle)
    /tmp/core-donor-labels-global-notarget.o(.text._ZN9b2Polygon3SetERKS_)
    /tmp/core-donor-labels-global-notarget.o(.text._ZN9b2Polygon18MergeParallelEdgesE5Fixed)
    /tmp/core-donor-labels-global-notarget.o(.text._Z10ConvexHullP5FixedS0_l)
    /tmp/core-donor-labels-global-notarget.o(.text._ZN9b2PolygonD1Ev)
    /tmp/core-donor-labels-global-notarget.o(.text._Z17ResolvePinchPointRK9b2PolygonRS_S2_)
    /tmp/core-donor-labels-global-notarget.o(.text._ZN9b2PolygonD2Ev)
    /tmp/core-donor-labels-global-notarget.o(.text._Z19PolygonizeTrianglesP10b2TrianglelP9b2Polygonl)
    /tmp/core-donor-labels-global-notarget.o(.text._Z5IsEarlP5FixedS0_l)
    /tmp/core-donor-labels-global-notarget.o(.text._ZN9b2PolygonC2EP5FixedS1_l)
    /tmp/core-donor-labels-global-notarget.o(.text._ZN9b2PolygonC2ER10b2Triangle)
    /tmp/core-donor-labels-global-notarget.o(.text._ZN9b2PolygonC2Ev)
    /tmp/core-donor-labels-global-notarget.o(.text._ZN9b2PolygonC1EP6b2Vec2l)
    /tmp/core-donor-labels-global-notarget.o(.text._ZN9b2PolygonC2EP6b2Vec2l)
    /tmp/core-donor-labels-global-notarget.o(.text._Z10ConvexHullP6b2Vec2i)
    /tmp/core-donor-labels-global-notarget.o(.text._ZN10b2PolyNodeC2Ev)
    /tmp/core-donor-labels-global-notarget.o(.text._ZN10b2PolyNodeC2ER6b2Vec2)
    /tmp/core-donor-labels-global-notarget.o(.text._Z41__static_initialization_and_destruction_0ii)
    /tmp/core-donor-labels-global-notarget.o(.text._GLOBAL__I__Z9intersectRK6b2Vec2S1_S1_S1_RS_)
    /tmp/core-donor-labels-global-notarget.o(.text._Z18TriangulatePolygonP5FixedS0_lP10b2Triangle)
    /tmp/core-donor-labels-global-notarget.o(.text._Z15DecomposeConvexP9b2PolygonS0_l)
    /tmp/core-donor-labels-global-notarget.o(.text._ZN9b2Polygon8IsUsableEb)
    /tmp/core-donor-labels-global-notarget.o(.text._ZN9b2Polygon8IsUsableEv)
    /tmp/core-cfg-exact-ext.o(.text._Z23DecomposeConvexAndAddToP7b2WorldP9b2PolygonP6b2BodyP12b2PolygonDef)
    /tmp/core-donor-labels-global-notarget.o(.text._ZN10b2PolyNode21GetRightestConnectionEPS_)
    /tmp/core-donor-labels-global-notarget.o(.text._ZN10b2PolyNode21GetRightestConnectionER6b2Vec2)
    /tmp/trace-standalone.o(.text._Z9TraceEdgeP9b2Polygon)
    /tmp/core-donor-labels-global-notarget.o(.text._ZN10b2TriangleD1Ev)
    /tmp/core-donor-labels-global-notarget.o(.text._ZN10b2TriangleD2Ev)
  }

  .rodata.str1.4 : { /tmp/core-donor-labels-global-notarget.o(.rodata.str1.4) }
  .rodata.trace.str1.4 : { /tmp/trace-standalone.o(.rodata.str1.4) }
  /DISCARD/ : {
    /tmp/core-donor-labels-global-notarget.o(.text._Z23DecomposeConvexAndAddToP7b2WorldP9b2PolygonP6b2BodyP12b2PolygonDef)
    /tmp/core-cfg-exact-ext.o(.text.* .bss .bss.* .data .data.* .init_array .rodata .rodata.*)
    /tmp/core-donor-labels-global-notarget.o(.text._Z22TraceEdgeCompilerStateP9b2Polygon)
    /tmp/trace-standalone.o(.text.* .bss .data .init_array)
  }
}
