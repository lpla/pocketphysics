/* Preserve historical method order and keep every input VMA at zero. */
SECTIONS
{
  .text.polygon.source.00 0 : { polygon-source.o(.text._Z9intersectRK6b2Vec2S1_S1_S1_RS_) }
  .text.polygon.source.01 0 : { polygon-source.o(.text._Z9intersectRK6b2Vec2S1_S1_S1_) }
  .text.polygon.source.02 0 : { polygon-source.o(.text._ZN9b2PolygonC1Ev) }
  .text.polygon.source.03 0 : { polygon-source.o(.text._ZN9b2Polygon7GetAreaEv) }
  .text.polygon.source.04 0 : { polygon-source.o(.text._ZN9b2Polygon5IsCCWEv) }
  .text.polygon.source.05 0 : { polygon-source.o(.text._ZN9b2Polygon8IsConvexEv) }
  .text.polygon.source.06 0 : { polygon-source.o(.text._ZN9b2Polygon8IsSimpleEv) }
  .text.polygon.source.07 0 : { polygon-source.o(.text._Z14ReversePolygonP5FixedS0_i) }
  .text.polygon.source.08 0 : { polygon-source.o(.text._Z14ReversePolygonR9b2Polygon) }
  .text.polygon.source.09 0 : { polygon-source.o(.text._Z9IsRighter5FixedS_S_S_) }
  .text.polygon.source.10 0 : { polygon-source.o(.text._Z9remainderll) }
  .text.polygon.source.11 0 : { polygon-source.o(.text._ZN10b2PolyNodeC1Ev) }
  .text.polygon.source.12 0 : { polygon-source.o(.text._ZN10b2PolyNodeC1ER6b2Vec2) }
  .text.polygon.source.13 0 : { polygon-source.o(.text._ZN10b2PolyNode23RemoveConnectionByIndexEl) }
  .text.polygon.source.14 0 : { polygon-membership.o(.text._ZN10b2PolyNode13IsConnectedToERS_) }
  .text.polygon.source.15 0 : { polygon-source.o(.text._ZN10b2PolyNode16RemoveConnectionERS_) }
  .text.polygon.source.16 0 : { polygon-source.o(.text._ZN10b2PolyNode13AddConnectionERS_) }
  .text.polygon.source.17 0 : { polygon-source.o(.text._ZN9b2PolygonC1ER10b2Triangle) }
  .text.polygon.source.18 0 : { polygon-source.o(.text._ZN9b2Polygon13GetVertexVecsEv) }
  .text.polygon.source.19 0 : { polygon-source.o(.text._ZN9b2PolygonC1EP5FixedS1_l) }
  .text.polygon.source.20 0 : { polygon-source.o(.text._ZN9b2Polygon5AddToER12b2PolygonDef) }
  .text.polygon.source.21 0 : { polygon-source.o(.text._ZN9b2Polygon3AddER10b2Triangle) }
  .text.polygon.source.22 0 : { polygon-source.o(.text._ZN9b2Polygon3SetERKS_) }
  .text.polygon.residual.23 0 : { polygon-residual.o(.text.polygon.residual.23) }
  .text.polygon.source.24 0 : { polygon-source.o(.text._Z10ConvexHullP5FixedS0_l) }
  .text.polygon.source.25 0 : { polygon-source.o(.text._ZN9b2PolygonD1Ev) }
  .text.polygon.source.26 0 : { polygon-source.o(.text._Z17ResolvePinchPointRK9b2PolygonRS_S2_) }
  .text.polygon.source.27 0 : { polygon-source.o(.text._ZN9b2PolygonD2Ev) }
  .text.polygon.source.28 0 : { polygon-source.o(.text._Z19PolygonizeTrianglesP10b2TrianglelP9b2Polygonl) }
  .text.polygon.source.29 0 : { polygon-source.o(.text._Z5IsEarlP5FixedS0_l) }
  .text.polygon.source.30 0 : { polygon-source.o(.text._ZN9b2PolygonC2EP5FixedS1_l) }
  .text.polygon.source.31 0 : { polygon-source.o(.text._ZN9b2PolygonC2ER10b2Triangle) }
  .text.polygon.source.32 0 : { polygon-source.o(.text._ZN9b2PolygonC2Ev) }
  .text.polygon.source.33 0 : { polygon-constructor.o(.text._ZN9b2PolygonC1EP6b2Vec2l) }
  .text.polygon.source.34 0 : { polygon-source.o(.text._ZN9b2PolygonC2EP6b2Vec2l) }
  .text.polygon.source.35 0 : { polygon-source.o(.text._Z10ConvexHullP6b2Vec2i) }
  .text.polygon.source.36 0 : { polygon-source.o(.text._ZN10b2PolyNodeC2Ev) }
  .text.polygon.source.37 0 : { polygon-source.o(.text._ZN10b2PolyNodeC2ER6b2Vec2) }
  .text.polygon.source.38 0 : { polygon-source.o(.text._Z41__static_initialization_and_destruction_0ii) }
  .text.polygon.source.39 0 : { polygon-source.o(.text._GLOBAL__I__Z9intersectRK6b2Vec2S1_S1_S1_RS_) }
  .text.polygon.residual.40 0 : { polygon-residual.o(.text.polygon.residual.40) }
  .text.polygon.source.41 0 : { polygon-source.o(.text._Z15DecomposeConvexP9b2PolygonS0_l) }
  .text.polygon.residual.42 0 : { polygon-residual.o(.text.polygon.residual.42) }
  .text.polygon.source.43 0 : { polygon-source.o(.text._ZN9b2Polygon8IsUsableEv) }
  .text.polygon.residual.44 0 : { polygon-residual.o(.text.polygon.residual.44) }
  .text.polygon.residual.45 0 : { polygon-residual.o(.text.polygon.residual.45) }
  .text.polygon.residual.46 0 : { polygon-residual.o(.text.polygon.residual.46) }
  .text.polygon.residual.47 0 : { polygon-residual.o(.text.polygon.residual.47) }
  .rodata.str1.4 0 : { polygon-residual.o(.rodata.str1.4) polygon-source.o(.rodata.str1.4) }
  .rodata.trace.str1.4 0 : { polygon-residual.o(.rodata.trace.str1.4) }
  .bss 0 : { polygon-source.o(.bss) }
  .data 0 : { polygon-source.o(.data) }
  .init_array 0 : { polygon-source.o(.init_array) }
  /DISCARD/ : { polygon-source.o(.text.* .rodata._ZTV*)
                 polygon-membership.o(.text.* .rodata* .bss* .data* .init_array)
                 polygon-constructor.o(.text.* .rodata* .bss* .data* .init_array) }
}
